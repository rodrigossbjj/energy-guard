## firmware/main/Kconfig.projbuild
```kconfig
menu "Configuração do Wi-Fi EnergyGuard"

    config ESP_WIFI_SSID
        string "WiFi SSID"
        default "EnergyGuard_WiFi"
        help
            SSID da rede Wi-Fi a ser conectada pelo ESP32.

    config ESP_WIFI_PASS
        string "WiFi Password"
        default "12345678"
        help
            Senha da rede Wi-Fi.

    config ESP_MAXIMUM_RETRY
        int "Número Máximo de Tentativas de Conexão"
        default 5
        help
            Quantidade de tentativas de reconexão antes de marcar falha no Wi-Fi.

endmenu

menu "Configuração do Backend EnergyGuard"

    config BACKEND_TELEMETRY_URL
        string "URL do Backend para Telemetria"
        default "http://192.168.1.14:8081/api/v1/telemetry"
        help
            URL completa do endpoint /api/v1/telemetry do backend Spring Boot.

endmenu
```
